## boards/shields/KobitoKey/Kconfig.defconfig
```kconfig
if SHIELD_KOBITOKEY_LEFT || SHIELD_KOBITOKEY_RIGHT

config ZMK_KEYBOARD_NAME
    default "KobitoKey"

config ZMK_SPLIT
    default y

endif

if SHIELD_KOBITOKEY_LEFT

config ZMK_SPLIT_ROLE_CENTRAL
    default y

endif
```
