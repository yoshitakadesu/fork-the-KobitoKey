## config/west.yml
```yaml
manifest:
  remotes:
    - name: zmkfirmware
      url-base: https://github.com/zmkfirmware
    - name: hsgw
      url-base: https://github.com/hsgw
    - name: caksoylar
      url-base: https://github.com/caksoylar  
    - name: prospector
      url-base: https://github.com/t-ogura
    
    /* ✨ 1. ここを追加：badjeffさんのGitHubの場所を登録します */
    - name: badjeff
      url-base: https://github.com/badjeff

  projects:
    # ZMK 本体
    - name: zmk
      remote: zmkfirmware
      revision: main
      import: app/west.yml
    
    # Sensor-rotation
    - name: zmk-feature-sensor_rotation
      remote: hsgw
      revision: main

    # LED
    - name: zmk-rgbled-widget
      remote: caksoylar
      revision: main

    # Prospector Scanner モジュール
    - name: prospector-zmk-module
      remote: prospector
      revision: main
      
    /* ✨ 2. ここを追加：ZMK 4.1対応の泳ぎ対策カスタムドライバーを読み込ませます */
    - name: zmk-pmw3610-driver
      remote: badjeff
      revision: zmk-0.4
      
  self:
    path: config
```
